## esp32/main/Kconfig.projbuild
```kconfig
menu "Rollo Konfiguration"

    config ROLLO_WIFI_SSID
        string "WLAN SSID"
        default "meinwlan"
        help
            Name des WLANs, mit dem sich die Rollladensteuerung verbindet.

    config ROLLO_WIFI_PASSWORD
        string "WLAN Passwort"
        default ""

    config ROLLO_HOSTNAME
        string "Hostname"
        default "rollo"
        help
            DHCP-Hostname. Viele Router loesen den Namen dann direkt auf,
            so dass http://rollo/ im Browser funktioniert.

    config ROLLO_NTP_SERVER
        string "NTP Server"
        default "pool.ntp.org"

    config ROLLO_TZ
        string "Zeitzone (TZ-String)"
        default "CET-1CEST,M3.5.0,M10.5.0/3"
        help
            POSIX-TZ-String. Default ist Europe/Berlin inklusive
            automatischer Sommer-/Winterzeit-Umschaltung.

endmenu
```
